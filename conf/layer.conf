## conf/layer.conf
```bitbake
# We have a conf and classes directory, add to BBPATH
BBPATH .= ":${LAYERDIR}"

# We have recipes-* directories, add to BBFILES
BBFILES += "${LAYERDIR}/recipes-*/*/*.bb ${LAYERDIR}/recipes-*/*/*.bbappend"

BBFILE_COLLECTIONS += "mali-opensource"
BBFILE_PATTERN_mali-opensource = "^${LAYERDIR}/"
BBFILE_PRIORITY_mali-opensource = "1"
LAYERSERIES_COMPAT_mali-opensource = "sumo"

# This should only be incremented on significant changes that will
# cause compatibility issues with other layers
LAYERVERSION_mali-opensource = "1"

LAYERDEPENDS_mali-opensource = "core"
```
